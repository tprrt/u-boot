## board/beagle/beaglev_ahead/Kconfig
```kconfig
if TARGET_BEAGLEV_AHEAD

config ARCH_THEAD
	bool
	default y

config SYS_BOARD
	default "beaglev_ahead"

config SYS_VENDOR
	default "beagle"

config SYS_CPU
	default "th1520"

config SYS_CONFIG_NAME
	default "beaglev_ahead"

config TEXT_BASE
	default 0x01b00000 if SPL
	default 0x01c00000 if !RISCV_SMODE
	default 0x01c00000 if RISCV_SMODE

config SPL_TEXT_BASE
	default 0xffe0000000

config SPL_OPENSBI_LOAD_ADDR
	default 0x80000000

config BOARD_SPECIFIC_OPTIONS
	def_bool y
	select ARCH_EARLY_INIT_R
	select THEAD_TH1520
	imply CPU
	imply CPU_RISCV
	imply RISCV_TIMER if RISCV_SMODE
	imply CMD_CPU
	imply SMP
	imply SUPPORT_OF_CONTROL
	imply OF_CONTROL
	imply OF_REAL

endif
```
